/*
 * This software is contributed or developed by KYOCERA Corporation.
 * (C) 2019 KYOCERA Corporation
 *
 * This program is free software; you can redistribute it and/or modify
 * it under the terms of the GNU General Public License version 2 and
 * only version 2 as published by the Free Software Foundation.
 *
 * This program is distributed in the hope that it will be useful,
 * but WITHOUT ANY WARRANTY; without even the implied warranty of
 * MERCHANTABILITY or FITNESS FOR A PARTICULAR PURPOSE.  See the
 * GNU General Public License for more details.
 */

#include "./module/bsp/ram/sdm429-HINOKI01-ram.dtsi"
#include "./module/usb/sdm429-HINOKI01-usb.dtsi"
#include "./module/pm/charger/sdm429-HINOKI01-charger.dtsi"
#include "./module/pm/fg/sdm429-HINOKI01-batterydata.dtsi"
#include "./module/pm/fg/sdm429-HINOKI01-fg.dtsi"
#include "./module/pm/hkadc/sdm429-HINOKI01-hkadc.dtsi"
#include "./module/keys/sdm429-HINOKI01-keys.dtsi"
#include "./module/display/sdm429-HINOKI01-display.dtsi"
#include "./module/touchscreen/sdm429-HINOKI01-himax.dtsi"
#include "./module/audio/sdm429-HINOKI01-audio.dtsi"
#include "./module/vib/sdm429-HINOKI01-vib.dtsi"
#include "./module/irda/sdm429-nfc-disable.dtsi"
#include "./module/irda/sdm429-HINOKI01-irda.dtsi"
#include "./module/camera/sdm429-HINOKI01-camera-pinctrl.dtsi"
#include "./module/camera/sdm429-HINOKI01-camera-sensor-mtp.dtsi"
#include "./module/flashdriver/sd/sdm429-HINOKI01-sd.dtsi"
