/*
 * This software is contributed or developed by KYOCERA Corporation.
 * (C) 2020 KYOCERA Corporation
 *
 * This program is free software; you can redistribute it and/or modify
 * it under the terms of the GNU General Public License version 2 and
 * only version 2 as published by the Free Software Foundation.
 *
 * This program is distributed in the hope that it will be useful,
 * but WITHOUT ANY WARRANTY; without even the implied warranty of
 * MERCHANTABILITY or FITNESS FOR A PARTICULAR PURPOSE.  See the
 * GNU General Public License for more details.
 */

/dts-v1/;
/plugin/;

#include "msm8917-HINOKI-common.dtsi"
#include "msm8917-HINOKI00.dtsi"
#include "./module/flashdriver/emmc/msm8917-HINOKI00-rev51-emmc.dtsi"

/ {
	model = "Qualcomm Technologies, Inc. APQ8017 or MSM8917  -PMI8950 HINOKI00 rev51";
	compatible = "qcom,apq8017", "qcom,msm8917", "kc,hinoki00";
	qcom,board-id = <0x00510005 0>;
};
