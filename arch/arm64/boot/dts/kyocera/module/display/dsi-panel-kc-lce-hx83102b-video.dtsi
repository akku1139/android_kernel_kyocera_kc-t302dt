/*
 * Copyright (c) 2015, The Linux Foundation. All rights reserved.
 *
 * This program is free software; you can redistribute it and/or modify
 * it under the terms of the GNU General Public License version 2 and
 * only version 2 as published by the Free Software Foundation.
 *
 * This program is distributed in the hope that it will be useful,
 * but WITHOUT ANY WARRANTY; without even the implied warranty of
 * MERCHANTABILITY or FITNESS FOR A PARTICULAR PURPOSE.  See the
 * GNU General Public License for more details.
 */
/*
 * This software is contributed or developed by KYOCERA Corporation.
 * (C) 2019 KYOCERA Corporation
 */

&mdss_mdp {
	dsi_hx83102_video: qcom,mdss_dsi_kc_lce_hx83102b_video {
		kc,panel-detect-enabled;
		qcom,mdss-dsi-panel-name = "hx83102 video mode dsi panel";
		qcom,mdss-dsi-panel-controller = <&mdss_dsi0>;
		qcom,mdss-dsi-panel-type = "dsi_video_mode";
		qcom,mdss-dsi-panel-framerate = <60>;
		qcom,mdss-dsi-virtual-channel-id = <0>;
		qcom,mdss-dsi-stream = <0>;
		qcom,mdss-dsi-panel-width = <720>;
		qcom,mdss-dsi-panel-height = <1440>;
		qcom,mdss-dsi-h-front-porch = <36>;
		qcom,mdss-dsi-h-back-porch = <32>;
		qcom,mdss-dsi-h-pulse-width = <12>;
		qcom,mdss-dsi-h-sync-skew = <2>;
		qcom,mdss-dsi-v-back-porch = <6>;
		qcom,mdss-dsi-v-front-porch = <170>;
		qcom,mdss-dsi-v-pulse-width = <2>;
		qcom,mdss-dsi-h-left-border = <0>;
		qcom,mdss-dsi-h-right-border = <0>;
		qcom,mdss-dsi-v-top-border = <0>;
		qcom,mdss-dsi-v-bottom-border = <24>;
		qcom,mdss-dsi-bpp = <24>;
		qcom,mdss-dsi-underflow-color = <0xff>;
		qcom,mdss-dsi-border-color = <0>;
		qcom,mdss-dsi-on-command = [05 01 00 00 00 00 02 11 00
				05 01 00 00 32 00 02 29 00
				39 01 00 00 00 00 04 B9 83 10 2D
				39 01 00 00 00 00 03 51 03 FF
				39 01 00 00 00 00 05 C9 04 08 E0 01
				39 01 00 00 00 00 02 53 2C
				39 01 00 00 05 00 02 55 01];
		qcom,mdss-dsi-off-command = [05 01 00 00 46 00 02 10 00];
		qcom,mdss-dsi-on-command-state = "dsi_lp_mode";
		qcom,mdss-dsi-off-command-state = "dsi_lp_mode";
		qcom,mdss-dsi-h-sync-pulse = <0>; //not sure
		qcom,mdss-dsi-traffic-mode = "non_burst_sync_event";
		qcom,mdss-dsi-lane-map = "lane_map_0123";
		qcom,mdss-dsi-bllp-eof-power-mode;
		qcom,mdss-dsi-bllp-power-mode;
		qcom,mdss-dsi-lane-0-state;
		qcom,mdss-dsi-lane-1-state;
		qcom,mdss-dsi-lane-2-state;
		qcom,mdss-dsi-lane-3-state;
		qcom,mdss-dsi-lp11-init;
		qcom,mdss-dsi-panel-timings =
					[88 1C 12 00 42 44 18 20 16 03 04 00];
		qcom,mdss-dsi-bl-min-level = <1>;
		qcom,mdss-dsi-bl-max-level = <4095>;
		qcom,mdss-dsi-dma-trigger = "trigger_sw";
		qcom,mdss-dsi-mdp-trigger = "none";
		qcom,mdss-dsi-bl-pmic-control-type = "bl_ctrl_dcs";
		qcom,mdss-dsi-bl-dcs-command-state = "dsi_hs_mode";
		qcom,mdss-dsi-reset-sequence = <1 2>, <0 2>, <1 50>;
		//qcom,mdss-dsi-post-init-delay = <1>;
		qcom,mdss-dsi-te-dcs-command = <1>;
		qcom,mdss-dsi-te-check-enable;
		qcom,mdss-dsi-te-using-te-pin;
		qcom,mdss-dsi-tx-eot-append;
		qcom,mdss-dsi-init-delay-us = <100>;
		qcom,esd-check-enabled;
		qcom,mdss-dsi-panel-status-check-mode = "reg_read";
		qcom,mdss-dsi-panel-status-command = [06 01 00 01 00 00 01 09];
		qcom,mdss-dsi-panel-status-command-state = "dsi_hs_mode";
		qcom,mdss-dsi-panel-status-value = <0x80 0x73 0x04>;
		//qcom,mdss-dsi-panel-on-check-value = <0x80>, <0x73>, <0x04>;
		qcom,mdss-dsi-panel-status-read-length = <3>;
		qcom,mdss-dsi-panel-max-error-count = <3>;
		qcom,mdss-dsi-panel-orientation = "180";
		qcom,mdss-pan-physical-width-dimension = <64>;
		qcom,mdss-pan-physical-height-dimension = <128>;

		qcom,mdss-dsi-t-clk-post = <0x0c>;
		qcom,mdss-dsi-t-clk-pre = <0x2c>;
		slr-mode-enabled;
		slr-mode-command-state = "dsi_lp_mode";
		slr-mode-strong-command = [39 01 00 00 00 00 04 B9 83 10 2D
				39 01 00 00 05 00 02 CE 20
				39 01 00 00 00 00 04 E4 2D 1C 00];
		slr-mode-medium-command = [39 01 00 00 00 00 04 B9 83 10 2D
				39 01 00 00 05 00 02 CE 20
				39 01 00 00 00 00 04 E4 2D 03 FF];
		slr-mode-weak-command = [39 01 00 00 00 00 04 B9 83 10 2D
				39 01 00 00 05 00 02 CE 20
				39 01 00 00 00 00 04 E4 2D 02 FF];
		slr-mode-off-command =[39 01 00 00 00 00 04 B9 83 10 2D
				39 01 00 00 05 00 02 CE 20
				39 01 00 00 00 00 04 E4 2D 01 2C];
		slr-mode-max = <3>;
	};
};
