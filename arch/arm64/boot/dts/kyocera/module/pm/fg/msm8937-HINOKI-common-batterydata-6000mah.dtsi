/*
 * This software is contributed or developed by KYOCERA Corporation.
 * (C) 2019 KYOCERA Corporation
*/
/* Copyright (c) 2014-2015, The Linux Foundation. All rights reserved.
 *
 * This program is free software; you can redistribute it and/or modify
 * it under the terms of the GNU General Public License version 2 and
 * only version 2 as published by the Free Software Foundation.
 *
 * This program is distributed in the hope that it will be useful,
 * but WITHOUT ANY WARRANTY; without even the implied warranty of
 * MERCHANTABILITY or FITNESS FOR A PARTICULAR PURPOSE.  See the
 * GNU General Public License for more details.
 */

qcom,msm8937-HINOKI-batterydata {
	qcom,max-voltage-uv = <4200000>;
	qcom,nom-batt-capacity-mah = <6000>;
	qcom,batt-id-kohm = <100>;
	qcom,battery-beta = <4250>;
	qcom,battery-type = "msm8937-HINOKI-batterydata";
	qcom,chg-rslow-comp-c1 = <2445225>;
	qcom,chg-rslow-comp-c2 = <3921338>;
	qcom,chg-rs-to-rslow = <322288>;
	qcom,chg-rslow-comp-thr = <0xB2>;
	qcom,checksum = <0x385A>;
	qcom,gui-version = "PMI8950GUI - 2.0.0.16";
	qcom,fg-profile-data = [
		 CF 83 B2 76
		 1F 7A C6 6E
		 3A 83 92 72
		 8C 7E 60 7A
		 F4 81 D2 9A
		 BF BD 9B CA
		 85 12 3A 88
		 3B 84 88 82
		 CB 7C 3B 83
		 26 78 56 84
		 B3 7B 2E 82
		 DB 99 01 BD
		 E7 C9 94 12
		 D0 14 F1 58
		 FB 6A 52 F8
		 F4 3D E1 3E
		 4E 38 00 00
		 6D 4C 6E 2B
		 56 42 00 00
		 00 00 00 00
		 00 00 00 00
		 7B 63 00 68
		 FA 72 DC 90
		 CC 76 7C 6A
		 73 76 DE 82
		 B9 76 5E 6A
		 C0 6C 65 A0
		 20 01 53 7F
		 4E A0 71 0C
		 28 00 FF 36
		 F0 11 30 03
		 00 00 00 0C
	];
};
