/*
 * This software is contributed or developed by KYOCERA Corporation.
 * (C) 2019 KYOCERA Corporation
 *
 * This program is free software; you can redistribute it and/or modify
 * it under the terms of the GNU General Public License version 2 and
 * only version 2 as published by the Free Software Foundation.
 *
 * This program is distributed in the hope that it will be useful,
 * but WITHOUT ANY WARRANTY; without even the implied warranty of
 * MERCHANTABILITY or FITNESS FOR A PARTICULAR PURPOSE.  See the
 * GNU General Public License for more details.
 */

&qpnp_smbcharger {
	qcom,dc-psy-type = "Mains";
	qcom,dc-psy-ma = <1100>;
	qcom,float-voltage-mv = <4200>;
	qcom,float-voltage-comp = <0x05>;
	qcom,fastchg-current-ma = <1800>;
	qcom,thermal-mitigation = <1800 1100 900 700 500 300 0>;
	qcom,bmd-pin-src = "bpd_none";
	qcom,bmd-algo-disabled;
	oem,enable-dcin-priority;
};
