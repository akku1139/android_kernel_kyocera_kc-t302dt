/*
 * This software is contributed or developed by KYOCERA Corporation.
 * (C) 2019 KYOCERA Corporation
 *
 * This program is free software; you can redistribute it and/or modify
 * it under the terms of the GNU General Public License version 2 and
 * only version 2 as published by the Free Software Foundation.
 *
 * This program is distributed in the hope that it will be useful,
 * but WITHOUT ANY WARRANTY; without even the implied warranty of
 * MERCHANTABILITY or FITNESS FOR A PARTICULAR PURPOSE.  See the
 * GNU General Public License for more details.
 */

/dts-v1/;
/plugin/;

#include "sdm429-HINOKI-common.dtsi"
#include "sdm429-HINOKI01.dtsi"

/ {
	model = "Qualcomm Technologies, Inc. SDM429 HINOKI01 rev10";
	compatible = "qcom,sdm429", "kc,hinoki10";
	qcom,board-id = <0x01100005 0>;
};
